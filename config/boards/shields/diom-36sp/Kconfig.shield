## config/boards/shields/diom-36sp/Kconfig.shield
```kconfig
config SHIELD_DIOM_36SP_LEFT
	def_bool $(shields_list_contains,diom_36sp_left)
	
config SHIELD_DIOM_36SP_RIGHT
	def_bool $(shields_list_contains,diom_36sp_right)
```

## config/boards/shields/diom36sp/Kconfig.shield
```kconfig
config SHIELD_DIOM36SP_LEFT
	def_bool $(shields_list_contains,diom_36sp_left)
	
config SHIELD_DIOM36SP_RIGHT
	def_bool $(shields_list_contains,diom_36sp_right)
```

## config/boards/shields/test/Kconfig.defconfig
```kconfig
# Copyright (c) 2021 The ZMK Contributors
# SPDX-License-Identifier: MIT

if SHIELD_test_LEFT

config ZMK_KEYBOARD_NAME
	default "TEST"

config ZMK_SPLIT_ROLE_CENTRAL
	default y

endif

if SHIELD_TEST_LEFT || SHIELD_TEST_RIGHT

config ZMK_SPLIT
	default y

endif
```

## config/boards/shields/test/Kconfig.shield
```kconfig
# Copyright (c) 2021 The ZMK Contributors
# SPDX-License-Identifier: MIT

config SHIELD_TEST_LEFT
	def_bool $(shields_list_contains,test_left)

config SHIELD_TEST_RIGHT
	def_bool $(shields_list_contains,test_right)
```
